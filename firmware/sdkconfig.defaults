## firmware/sdkconfig.defaults
```kconfig
CONFIG_IDF_TARGET="esp32s3"

# ESP32-S3-Zero has a single USB-C port wired to the native USB pins
# (GPIO19/20), which this firmware switches into USB-OTG *host* mode at
# runtime to talk to the Stream Deck. That leaves nothing free for a USB
# serial console, so route the console to UART0 instead — the board breaks
# this out separately on GPIO43 (TX) / GPIO44 (RX), which happen to be the
# chip's default UART0 pins already, so no pin remapping is needed. See
# docs/hardware.md for the external USB-to-serial adapter wiring.
CONFIG_ESP_CONSOLE_UART_DEFAULT=y
CONFIG_ESP_CONSOLE_UART_NUM=0
CONFIG_ESP_CONSOLE_UART_BAUDRATE=115200
```
